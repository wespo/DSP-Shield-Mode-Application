#include "ddsCode.h"
#include "Audio_exposed.h"
int phase_to_amplitude_l[DDS_LENGTH] = {0};//{0,13,25,38,50,63,75,88,101,113,126,138,151,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-25,-13};
int phase_to_amplitude_r[DDS_LENGTH] = {0};//
int phase_to_amplitude_type_l = -1;
int phase_to_amplitude_type_r = -1;
float fs = 44100;
int numBits = 32;

extern interrupt void dmaIsr(void);
ddsConfig ddsConfigLeft, ddsConfigRight;
void ddsGen(ddsConfig &config, int buffer[], int frameSize)
{
  if(config.enable == 1)
  {
    //generate size samples of DDS output
    for(int i = 0; i < frameSize; i++)
    {
      unsigned long tempPhase; //calculated phase for this sample
      
      //increment the phase accumulator by the value stored in the tuning word.
      config.phaseAccumulator += config.tuningWord; //32 bits
    
      //peel off top 12 bits
      tempPhase = (unsigned long)(config.phaseAccumulator >> 19); //use only top 14 bits of 32 bit phase accumulator
      if(config.muxMode == MUX_OVERWRITE) //overwrite mode
      {
        long a = config.phaseToAmplitude[tempPhase]>>1;
        long b = config.gain;
        long c = ((long)(a * b)) >> 15;
        buffer[i] = (int) c;
      }
      else if(config.muxMode == MUX_SUM) //sum mode. Scale by two to prevent overflows.
      {
        long a = config.phaseToAmplitude[tempPhase]>>1;
        long b = config.gain;
        long c = ((long)(a * b)) >> 16;
        buffer[i] >>= 1;
        buffer[i] += (int) c;
      }
    }
    if(config.tuningStop != 0)
    {
      if(((config.tuningStop > config.tuningStart) && (config.tuningWord < config.tuningStop)) || ((config.tuningStop < config.tuningStart) && (config.tuningWord > config.tuningStop))) //ramp up or down
      {
        config.tuningWord += config.tuningIncrement;
      }
      else
      {
        if(config.chirpLoopFlag == 1) //if we are supposed to loop, do so. Else repeat.
        {
          config.tuningWord = config.tuningStart;
        }
        else if(config.chirpLoopFlag == 0) //we are supposed to hold
        {
          config.tuningIncrement = 0;
        }
        else //if (config.chirpLoopFlag == 2) //we are supposed to stop.
        {
        	config.enable = 0;
        	config.tuningIncrement = 0;
        	config.tuningWord = config.tuningStart;
        }
      }
    }
  }
}

void ddsConfigInit(ddsConfig &config)
{
  config.enable = 0;
  config.phaseAccumulator = 0;
  config.tuningIncrement = 0;
  config.tuningStart = 0;
  config.tuningStop = 0;
  config.tuningWord = 97391549;
  config.chirpLoopFlag = 1;
  config.gain = 0.3;
  config.muxMode = 0;
  config.wavType = -1;
  config.phaseToAmplitude = phase_to_amplitude_l;
}

void loadWave(int type, int channel, bool doubleBuffFlag) //int* target
{
    int* doubleBuff;
    //select pointer to buffer for the correct channel
    int* dest = phase_to_amplitude_l;
    if(channel == CHAN_RIGHT)
    {
      dest = phase_to_amplitude_r;
    }
    
    //check if target channel type matches new target type. If it does, we can skip loading altogether.
    if((phase_to_amplitude_type_l == type) && ((channel == CHAN_LEFT) || (channel == CHAN_BOTH))) //if the target wave is already loaded, skip loading.
    {
      return;
    }
    if((phase_to_amplitude_type_r == type) && (channel == CHAN_RIGHT))
    {
      return;
    }

    if(doubleBuffFlag == true)
    {
      doubleBuff = (int*) malloc(DDS_LENGTH); //to get rid of double buffering, remove this.
    }
    else
    {
      doubleBuff = dest;
    }

    File          fileHandle;

    char fileName[12] = "wav/sin.dat"; //default file name
    if(type == WAV_SQU)
   {
     fileName[4] = 's';
     fileName[5] = 'q';
     fileName[6] = 'u';
   }
   else if(type == WAV_TRI)
   {
     fileName[4] = 't';
     fileName[5] = 'r';
     fileName[6] = 'i';       
   }
   else if(type == WAV_SAW)
   {
     fileName[4] = 's';
     fileName[5] = 'a';
     fileName[6] = 'w';
   }
   else if(type == WAV_WHT) //white noise
   {
     fileName[4] = 'w';
     fileName[5] = 'h';
     fileName[6] = 't';
   }
   else if(type == WAV_USR) //white noise
   {
     fileName[4] = 'u';
     fileName[5] = 's';
     fileName[6] = 'r';
   }

    //if (TRUE == status)
    if(1)
   {
      #ifdef AUDIO_INTERRUPTION
      AudioC.detachIntr(); //turning off the audio fixes audio / sd card collision
      #endif

      fileHandle = SD.open(fileName, FILE_READ);
      if(fileHandle)
      {

         fileHandle.seek(0);    
         fileHandle.read(doubleBuff, DDS_LENGTH); //load the data. To get rid of double buffering, change this to dest
         fileHandle.close();
         #ifdef AUDIO_INTERRUPTION
         bool status = AudioC.Audio(TRUE);
         AudioC.setSamplingRate(SAMPLING_RATE_44_KHZ);
         if (status == 0)
         {
           AudioC.attachIntr(dmaIsr);
         }
         #endif
         for(int i = 0; i < DDS_LENGTH; i++) //fix endian-ness of dataset.
         {
           int temp = doubleBuff[i]; //to get red of double buffering, change this to dest
           dest[i] = ((temp & 0x00FF)<<8) + ((temp * 0xFF00)>>8);
         }
         
        if((channel == CHAN_LEFT) || (channel == CHAN_BOTH)) //mark wavetype loaded in appropriate buffer.
        {
          phase_to_amplitude_type_l = type;
        }
        if(channel == CHAN_RIGHT)
        {
          phase_to_amplitude_type_r = type;
        }

        }
      else
      {
//        Serial.begin(115200);    
//        Serial.println("File Open Failed");
//        Serial.end();
      }

   } 
    if(doubleBuffFlag == true)
    {
      free(doubleBuff);
    }
   
   return;
}

unsigned long computeTuningWord(float f)
{
  return (long)(((float)f)/fs*pow(2,numBits));
}

long computeRamp(float fStart, float fEnd, unsigned int duration)
{
  unsigned long tuningWordStart = computeTuningWord(fStart);
  unsigned long tuningWordFinish = computeTuningWord(fEnd);
  //step = tuning word increment / frames to sweep.
  //
  long deltaTW = tuningWordFinish - tuningWordStart; 
  
  float numFrames = duration *  fs / (I2S_DMA_BUF_LEN * 1000.0);
  long tuningStepPerFrame = deltaTW/numFrames;
  
  return tuningStepPerFrame;
}
ddsConfig ddsInit(int command, float fStart, float fEnd, float gain, int chirpLoop, unsigned int duration, int sumMode, int type)
{
     long tuningIncrement = 0; //increment per frame, for chirp
     unsigned long tuningStop = 0; //maximum frequency of chirp
     if((fStart != fEnd) && (duration != 0)) //compute chirp values if there is a delta f. If not, leave at zero.
     {
       tuningIncrement = computeRamp(fStart, fEnd, duration);
       tuningStop = computeTuningWord(fEnd);
     }
     ddsConfig newConfig; //structure for the new configuration
     ddsConfigInit(newConfig);
     if((fStart < (fs/2)) && (fEnd < (fs/2)) && (gain <= 1.0)) //check validity.
     {
       long tuningWord = computeTuningWord(fStart); //computer tuning word for start frequency

       //populate the new configuration
       newConfig.tuningWord = tuningWord;
       newConfig.tuningStart = tuningWord;
       newConfig.tuningIncrement = tuningIncrement;
       newConfig.tuningStop = tuningStop;
       newConfig.muxMode = sumMode;
       newConfig.wavType = type;
       newConfig.chirpLoopFlag = chirpLoop;
       newConfig.gain = int(gain*32767);
       newConfig.enable = 1;
       newConfig.phaseToAmplitude = phase_to_amplitude_l;
     }
    return newConfig;
}

void ddsChirpStart(int channel, int command)
{
   float fDDSEnd;
   bool switch1;
   ddsConfig newConfig;
   float fDDS, gain;
   //parse out two floats, frequency and gain from mailbox.
   long recon = (shieldMailbox.inbox[7]<<8) + shieldMailbox.inbox[6];
   recon <<= 16;
   recon += (shieldMailbox.inbox[5]<<8) + shieldMailbox.inbox[4];
   memcpy(&fDDS, &recon, sizeof(fDDS));
   recon = (shieldMailbox.inbox[11]<<8) + shieldMailbox.inbox[10];
   recon <<= 16;
   recon += (shieldMailbox.inbox[9]<<8) + shieldMailbox.inbox[8];
   memcpy(&fDDSEnd, &recon, sizeof(fDDSEnd));
   recon = (shieldMailbox.inbox[15]<<8) + shieldMailbox.inbox[14];
   recon <<= 16;
   recon += (shieldMailbox.inbox[13]<<8) + shieldMailbox.inbox[12];
   memcpy(&gain, &recon, sizeof(gain));     
   int duration = (shieldMailbox.inbox[17]<<8) + shieldMailbox.inbox[16];
   int chirpLoop = (shieldMailbox.inbox[19]<<8) + shieldMailbox.inbox[18];
   int sumMode = (shieldMailbox.inbox[21]<<8) + shieldMailbox.inbox[20];
   int type = (shieldMailbox.inbox[23]<<8) + shieldMailbox.inbox[22];
   switch1 = (shieldMailbox.inbox[25]<<8) + shieldMailbox.inbox[24];
     //store the new configuration in selected channel(s)
     newConfig = ddsInit(command, fDDS, fDDSEnd, gain, chirpLoop, duration, sumMode, type);
     loadWave(newConfig.wavType, channel, switch1); //fills phase to amplitude buffer.
     if(channel == CHAN_LEFT)
     {
      ddsConfigLeft = newConfig;
     }
     else if(channel == CHAN_RIGHT)
     {
      newConfig.phaseToAmplitude = phase_to_amplitude_r;
      ddsConfigRight = newConfig;
     }
     else if(channel == CHAN_BOTH)
     {
      ddsConfigLeft = newConfig;
      newConfig.phaseToAmplitude = phase_to_amplitude_r;
      memcpy(phase_to_amplitude_r, phase_to_amplitude_l, DDS_LENGTH); //if both channels, we have to copy the buffer over.
      ddsConfigRight = newConfig;
     }
}

void ddsToneStart(int channel, int command)
{
  //parse out two floats, frequency and gain from mailbox.
   float fDDS, gain;
   long recon = (shieldMailbox.inbox[7]<<8) + shieldMailbox.inbox[6];
   recon <<= 16;
   recon += (shieldMailbox.inbox[5]<<8) + shieldMailbox.inbox[4];
   memcpy(&fDDS, &recon, sizeof(fDDS));
   recon = (shieldMailbox.inbox[11]<<8) + shieldMailbox.inbox[10];
   recon <<= 16;
   recon += (shieldMailbox.inbox[9]<<8) + shieldMailbox.inbox[8];
   memcpy(&gain, &recon, sizeof(gain));
   int sumMode = (shieldMailbox.inbox[13]<<8) + shieldMailbox.inbox[12];
   int type = (shieldMailbox.inbox[15]<<8) + shieldMailbox.inbox[14];
   int switch1 = (shieldMailbox.inbox[17]<<8) + shieldMailbox.inbox[16];
   ddsConfig newConfig = ddsInit(command, fDDS, fDDS, gain, 0, 0, sumMode, type); //ddsInit builds a configuration
   loadWave(newConfig.wavType, channel, switch1); //fills phase to amplitude buffer.
   if(channel == CHAN_LEFT)
   {
    ddsConfigLeft = newConfig;
   }
   else if(channel == CHAN_RIGHT)
   {
    newConfig.phaseToAmplitude = phase_to_amplitude_r;
    ddsConfigRight = newConfig;
   }
   else if(channel == CHAN_BOTH)
   {
    ddsConfigLeft = newConfig;
    newConfig.phaseToAmplitude = phase_to_amplitude_r;
    memcpy(phase_to_amplitude_r, phase_to_amplitude_l, DDS_LENGTH); //if both channels, we have to copy the buffer over.
    ddsConfigRight = newConfig;
   }
}

void ddsStop(int channel)
{
   if(channel == CHAN_LEFT)
   {
     ddsConfigLeft.enable = 0;
   }
   else if(channel == CHAN_RIGHT)
   {
     ddsConfigRight.enable = 0;
   }
   else if(channel == CHAN_BOTH)
   {
     ddsConfigLeft.enable = 0;
     ddsConfigRight.enable = 0;
   }
}
  
